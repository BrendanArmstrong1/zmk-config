## config/boards/shields/sweep36/Kconfig.defconfig
```kconfig
# Copyright (c) 2022 The ZMK Contributors
# SPDX-License-Identifier: MIT

if SHIELD_SWEEP36_LEFT

config ZMK_KEYBOARD_NAME
    default "Brendan Split"

config ZMK_SPLIT_ROLE_CENTRAL
    default y

endif # SHIELD_SWEEP36_LEFT 

if SHIELD_SWEEP36_LEFT || SHIELD_SWEEP36_RIGHT

config ZMK_SPLIT
    default y


endif # SHIELD_SWEEP36_LEFT || SHIELD_SWEEP36_RIGHT
```

## config/boards/shields/sweep36/Kconfig.shield
```kconfig
# Copyright (c) 2022 The ZMK Contributors
# SPDX-License-Identifier: MIT

config SHIELD_SWEEP36_LEFT
    def_bool $(shields_list_contains,sweep36_left)

config SHIELD_SWEEP36_RIGHT
    def_bool $(shields_list_contains,sweep36_right)
```
